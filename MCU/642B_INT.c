/*==============================================================================
                Copyright(C) 1997-2019.  Sinowealth Tech. Co., Ltd.
--------------------------------------------------------------------------------
Project Name  : _642B_INT.c
Description   :
Notice        :
			 1:
			 2:
Author        : James.wang (email: James.wang@sinowealth.com)
Start Date    : 2015/11/08
Approve Date  :
Version       : V0.0
Function List :
             1:
             2:
RevisionHistory:
Rev#  CheckSum    Date     Author     Comments(Function+Date)
-----+--------+----------+---------+------------------------------------------
0.0     XXXX   2015/11/08 james.wang Just build the file
==============================================================================*/

//-------------------------------------------------------------------------------
#ifndef  _642B_INT_C
	#define  _642B_INT_C
#endif
//-------------------------------------------------------------------------------

//---------------


#include "config.h"
#include "Headconfig.h"



////////////////////////////////////////////////////////////////////////////////////////////
/*******************************************************************************************
** 函数名称: Timer0_ISP
** 功能描述: TIMER0中断服务程序 25ms时基
** 入口参数: 无
** 出口参数: 无
********************************************************************************************/
void Timer0_ISP(void) interrupt 1				  //25ms
{
	EA	= 0;
	TF0 = 0;
    /*
     //Reload the Timer0
	TL0 = T0_25MS_CNT & 0x00FF;	                              //送重载初值
	TH0 = (T0_25MS_CNT>>8) & 0xFF;


	gbFgUart5ms = 1;

//TEST/////////////////////////
// P2_1 = ~P2_1;
//TEST/////////////////////////

	WDTCount10ms++;
	if(WDTCount10ms > 5)
	{
		WDTCount10ms = 0;

	    //For watchdog
		gBTime0Flag = 0xA5;

	    //For scankey
	    gbFgKey25ms = 1;

	    //For Sag check delay,250ms
		if(PwrCnt != 0x0A)
		{
			PwrCnt++;
		}

	    //Key Process
	//    if (KEY1_DOWN())
	//    {
	//        keytime[0]++;
	//        if (keytime[0] == 4)
	//        {
	//            g_Disp.PollingDisplayCount=30;
	//            g_Disp.PollingDisplayPtr++;
	//            g_Disp.KeyDisplaySet=0xAC;
	//            g_Flag.Run |= F_DISP;
	//        }
	//        else if (keytime[0] > 5)
	//        {
	//            keytime[0] = 5;
	//        }
	//    }
	//    else
	//    {
	//        keytime[0] = 0;
	//    }


	} */

	EA=1;
}

////////////////////////////////////////////////////////////////////////////////////////////
/*******************************************************************************************
** 函数名称: INT1_ISP
** 函数描述: 外部中断1中断服务程序
** 输入参数: 无
** 输出参数: 无
*******************************************************************************************/
void INT1_ISP(void) interrupt 2
{
	EA=0;
	IE1=0;
	//在此加入您要处理的代码
	EA=1;
}

////////////////////////////////////////////////////////////////////////////////////////////
/*****************************************************************************************
** 函数名称: Timer1_ISP
** 功能描述: TIMER1中断服务程序
** 入口参数: 无
** 出口参数: 无
******************************************************************************************/

void Timer1_ISP(void) interrupt 3
{
    EA = 0;
    TF1 = 0;
	//TF1 = 0;
	//10ms定时器中断
	  TL1		=	(2^16-3412)&0x00FF;
	  TH1		=	((2^16-3412)>>8)&0xFF;
	  WDTCount10ms ++;	//看门狗计数器
	  NBCount10ms ++;	//NB接收等待计数器

	  if(WDTCount10ms >3)
	  {
			//For watchdog
		gBTime0Flag = 0xA5;
		WDTCount10ms = 0;
	  }

	//------------------------------------------------
	UartRxdTimeout();
	//------------------------------------------------
	//在此加入您要处理的代码
    EA = 1;
}

////////////////////////////////////////////////////////////////////////////////////////////
/*******************************************************************************************
** 函数名称: Timer2_ISP
** 函数描述: Timer2中断服务程序
** 输入参数: 无
** 输出参数: 无
*******************************************************************************************/
void Timer2_ISP(void) interrupt 5
{
	EA=0;
	TF2=0;
	EXF2=0;
	//在此加入您要处理的代码
	EA=1;
}

////////////////////////////////////////////////////////////////////////////////////////////
/*******************************************************************************************
** 函数名称: ADC_ISP
** 函数描述: AD中断服务程序
** 输入参数: 无
** 输出参数: 无
*******************************************************************************************/
void ADC_ISP(void) interrupt 6
{
	EA=0;
	/* ADCON &= Bin(10111111);	    //清ADCIF

	#if MCU_642B == ENABLE
    TPCON &= Bin(10111111);     //清TPSIF
	#endif
 */
	//在此加入您要处理的代码
	EA=1;
}

////////////////////////////////////////////////////////////////////////////////////////////
/*******************************************************************************************
** 函数名称: EMU_ISP
** 函数描述: EMU中断服务程序
** 输入参数: 无
** 输出参数: 无
*******************************************************************************************/
void EMU_ISP(void) interrupt 7
{
	EA = 0;
	 EXF0 &= Bin(10111111);//清中断标志

	//仅使能有功脉冲PF输出，未使能无功脉冲QF输出
	//绝对值累加，无正向，反向之分
	if (EMUIF & Bin(00001000))          //有功脉冲输出
	{
		gbPCNTCount=0x00;				//清潜动的计时计数器

		// if (EMUSR & Bin(00000001))
		// {
		// 	RKWHP++;      				//反向
		// }
		// else
		// {
			KWHP++;       				//有功脉冲累加
		// }

		//g_Demand.Max0++;	//需量相关，不需要
	}

	/* if (EMUIF & Bin(00010000))          //无功脉冲输出
	{
		gbPCNTCount=0x00;				//清潜动的计时计数器

		if (EMUSR & Bin(00000010))
		{
			RQKWHP++;      				//反向	无功电容电能量是负的
		}
		else
		{
			QKWHP++;       				//正向	 无功电感电能量是正的
		}

		//		g_Demand.Max0++;
	}
 */
	EMUIF = Bin(00000000);
	EA = 1;
}


////////////////////////////////////////////////////////////////////////////////////////////
/*******************************************************************************************
** 函数名称: HSEC_ISP
** 函数描述: 半秒中断服务程序
** 输入参数: 无
** 输出参数: 无
*******************************************************************************************/
void HSEC_ISP(void) interrupt 10			//现在设置是1秒
{
	EA=0;

     if ((RTCIF & 0x08) == 0x08)     		//RTC秒中断标志
	{
        g_ClkSec++;

    	gbSecFlag = 1;
        gbAdjSecFlag = 1;					//功率校表时的秒标志
        //gbPIMASecFlag = 1;					//PIMA 5s发送的时间的秒标志


       // #if TCoverChk == ENABLE
        //gbSecFlagOpenKey = 1;				//in battery mode one second flag
       // #endif
    	gBCountFlag = 0xA5;					//每秒看门狗复位标志
    }

    RTCIF = 0;    							//所有RTC中断标志全部清零
	 EA=1;
}

////////////////////////////////////////////////////////////////////////////////////////////
/*******************************************************************************************
** 函数名称: PWM_ISP
** 函数描述: PWM中断服务程序
** 输入参数: 无
** 输出参数: 无
*******************************************************************************************/
void PWM_ISP(void) interrupt 12
{
	EA	=	0;
    // PWM0CON &= Bin(11111101);
    // PWM1CON &= Bin(11111101);
	//在此加入您要处理的代码
	EA	=	1;
}

////////////////////////////////////////////////////////////////////////////////////////////
/*******************************************************************************************
** 函数名称: LPD_ISP
** 函数描述: 掉电检测中断服务程序
** 输入参数: 无
** 输出参数: 无
*******************************************************************************************/
void LPD_ISP(void) interrupt 14
{
	EA=0;

	if(((LPDCON & Bin(00001000)) == Bin(00000000)) || (SAG_CHECK())) //VDD < 2.7V
	//if(((LPDCON & Bin(01000000)) == Bin(00000000)) || (SAG_CHECK()))//VIN <1.2V

	{
		EEPromByteProgram_INT(0x05,0x31,KWHP);
		EEPromByteProgram_INT(0x05,0x32,KWHD);
		EEPromByteProgram_INT(0x05,0x01,0xAA);
		//执行保存小数点电能和脉冲数程序
		//PluseAndDecimalProc();					//脉冲数和小数电量
        //EnergyProc();							//整数电量处理
	}

	EA=1;
}

////////////////////////////////////////////////////////////////////////////////////////////
/*******************************************************************************************
** 函数名称: OVL_ISP
** 函数描述: 跑飞中断服务程序
** 输入参数: 无
** 输出参数: 无
*******************************************************************************************/
void OVL_ISP(void) interrupt 15
{
	EA=0;
	//while (1);
	//在此加入您要处理的代码
    EA=1;
}
